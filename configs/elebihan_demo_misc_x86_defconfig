## configs/elebihan_demo_misc_x86_defconfig
```kconfig
BR2_x86_pentiumpro=y
BR2_KERNEL_HEADERS_VERSION=y
BR2_DEFAULT_KERNEL_VERSION="3.10.7"
BR2_TOOLCHAIN_BUILDROOT_LARGEFILE=y
BR2_TOOLCHAIN_BUILDROOT_INET_IPV6=y
BR2_TOOLCHAIN_BUILDROOT_INET_RPC=y
BR2_TOOLCHAIN_BUILDROOT_LOCALE=y
BR2_BINUTILS_VERSION_2_23_2=y
BR2_GCC_VERSION_4_8_X=y
BR2_TOOLCHAIN_BUILDROOT_CXX=y
BR2_ROOTFS_DEVICE_CREATION_DYNAMIC_MDEV=y
BR2_TARGET_GENERIC_ROOT_PASSWD="root"
BR2_ROOTFS_OVERLAY="board/elebihan/demo-misc/fs-overlay"
BR2_ROOTFS_POST_BUILD_SCRIPT="board/elebihan/demo-misc/post-build.sh"
BR2_LINUX_KERNEL=y
BR2_LINUX_KERNEL_CUSTOM_VERSION=y
BR2_LINUX_KERNEL_CUSTOM_VERSION_VALUE="3.10.7"
BR2_LINUX_KERNEL_USE_CUSTOM_CONFIG=y
BR2_LINUX_KERNEL_CUSTOM_CONFIG_FILE="board/elebihan/demo-misc/x86/linux-3.10.config"
BR2_PACKAGE_BUSYBOX_SHOW_OTHERS=y
BR2_PACKAGE_STRACE=y
BR2_PACKAGE_ARCHIVEMOUNT=y
BR2_PACKAGE_ZLIB=y
BR2_PACKAGE_DHCPCD=y
BR2_PACKAGE_DROPBEAR=y
BR2_TARGET_ROOTFS_EXT2=y
# BR2_TARGET_ROOTFS_TAR is not set
```

## configs/elebihan_demo_pygtk_x86_defconfig
```kconfig
BR2_x86_pentiumpro=y
BR2_KERNEL_HEADERS_VERSION=y
BR2_DEFAULT_KERNEL_VERSION="3.10.7"
BR2_TOOLCHAIN_BUILDROOT_LARGEFILE=y
BR2_TOOLCHAIN_BUILDROOT_INET_IPV6=y
BR2_TOOLCHAIN_BUILDROOT_INET_RPC=y
BR2_TOOLCHAIN_BUILDROOT_LOCALE=y
BR2_TOOLCHAIN_BUILDROOT_CXX=y
BR2_ROOTFS_DEVICE_CREATION_DYNAMIC_UDEV=y
BR2_TARGET_GENERIC_ROOT_PASSWD="root"
BR2_TARGET_GENERIC_GETTY_PORT="tty0"
BR2_ROOTFS_OVERLAY="board/elebihan/demo-pygtk/fs-overlay"
BR2_ROOTFS_POST_BUILD_SCRIPT="board/elebihan/demo-pygtk/post-build.sh"
BR2_LINUX_KERNEL=y
BR2_LINUX_KERNEL_CUSTOM_VERSION=y
BR2_LINUX_KERNEL_CUSTOM_VERSION_VALUE="3.10.7"
BR2_LINUX_KERNEL_USE_CUSTOM_CONFIG=y
BR2_LINUX_KERNEL_CUSTOM_CONFIG_FILE="board/elebihan/demo-pygtk/x86/linux-3.10.config"
BR2_PACKAGE_BUSYBOX_SHOW_OTHERS=y
BR2_PACKAGE_XORG7=y
BR2_PACKAGE_XSERVER_XORG_SERVER=y
BR2_PACKAGE_XSERVER_XORG_SERVER_MODULAR=y
BR2_PACKAGE_XAPP_SETXKBMAP=y
BR2_PACKAGE_XAPP_TWM=y
BR2_PACKAGE_XAPP_XINIT=y
BR2_PACKAGE_XAPP_XINPUT=y
BR2_PACKAGE_XDRIVER_XF86_INPUT_EVDEV=y
BR2_PACKAGE_XDRIVER_XF86_INPUT_KEYBOARD=y
BR2_PACKAGE_XDRIVER_XF86_INPUT_MOUSE=y
BR2_PACKAGE_XDRIVER_XF86_VIDEO_CIRRUS=y
BR2_PACKAGE_XDRIVER_XF86_VIDEO_FBDEV=y
BR2_PACKAGE_XDRIVER_XF86_VIDEO_VESA=y
BR2_PACKAGE_MCOOKIE=y
BR2_PACKAGE_XTERM=y
BR2_PACKAGE_FLUXBOX=y
BR2_PACKAGE_KBD=y
BR2_PACKAGE_PYTHON=y
BR2_PACKAGE_PYTHON_PYGTK=y
BR2_PACKAGE_DHCPCD=y
BR2_PACKAGE_DROPBEAR=y
BR2_TARGET_ROOTFS_EXT2=y
# BR2_TARGET_ROOTFS_TAR is not set
```

## configs/elebihan_demo_runit_x86_defconfig
```kconfig
BR2_x86_pentiumpro=y
BR2_KERNEL_HEADERS_VERSION=y
BR2_DEFAULT_KERNEL_VERSION="3.10.7"
BR2_TOOLCHAIN_BUILDROOT_LARGEFILE=y
BR2_TOOLCHAIN_BUILDROOT_INET_IPV6=y
BR2_TOOLCHAIN_BUILDROOT_INET_RPC=y
BR2_TOOLCHAIN_BUILDROOT_WCHAR=y
BR2_TOOLCHAIN_BUILDROOT_CXX=y
BR2_ROOTFS_DEVICE_CREATION_DYNAMIC_MDEV=y
BR2_TARGET_GENERIC_ROOT_PASSWD="root"
BR2_TARGET_GENERIC_GETTY_PORT="tty1"
BR2_ROOTFS_OVERLAY="board/elebihan/demo-runit/fs-overlay"
BR2_LINUX_KERNEL=y
BR2_LINUX_KERNEL_CUSTOM_VERSION=y
BR2_LINUX_KERNEL_CUSTOM_VERSION_VALUE="3.10.7"
BR2_LINUX_KERNEL_USE_CUSTOM_CONFIG=y
BR2_LINUX_KERNEL_CUSTOM_CONFIG_FILE="board/elebihan/demo-runit/x86/linux-3.10.config"
BR2_PACKAGE_BUSYBOX_SHOW_OTHERS=y
BR2_PACKAGE_STRACE=y
BR2_PACKAGE_KBD=y
BR2_PACKAGE_DROPBEAR=y
BR2_PACKAGE_IPSVD=y
BR2_PACKAGE_IPTABLES=y
BR2_PACKAGE_PSMISC=y
BR2_PACKAGE_RUNIT=y
BR2_TARGET_ROOTFS_EXT2=y
# BR2_TARGET_ROOTFS_TAR is not set
```

## fs/miniramfs/Config.in
```kconfig
config BR2_TARGET_ROOTFS_MINIRAMFS
	bool "Create minimal companion ramfs"
	depends on !BR2_TARGET_ROOTFS_INITRAMFS
	select BR2_PACKAGE_BUSYBOX
	help
	  Generate a minimal ramfs suitable to finding, verifying and
	  mounting the real rootfs stored in MTD or encrypted on a disk.

if BR2_TARGET_ROOTFS_MINIRAMFS

config BR2_TARGET_ROOTFS_MINIRAMFS_OVERLAY
	string "Path to the ramfs overlay"
	help
	  Path to the directory to use as overlay for the minimal ramfs.

config BR2_TARGET_ROOTFS_MINIRAMFS_INITRAMFS
	bool "Use as initramfs"
	depends on BR2_LINUX_KERNEL
	help
	  Use miniramfs as Linux initramfs.

endif
```

## package/archivemount/Config.in
```kconfig
config BR2_PACKAGE_ARCHIVEMOUNT
	bool "archivemount (FUSE)"
	select BR2_PACKAGE_LIBFUSE
	select BR2_PACKAGE_LIBARCHIVE
	depends on BR2_USE_WCHAR # libarchive
	depends on BR2_TOOLCHAIN_HAS_THREADS # libfuse
	depends on BR2_USE_MMU # libfuse
	depends on !BR2_PREFER_STATIC_LIB # libfuse
	help
	  Implements a file system for accessing archives
	  (like tar.gz or zip) using FUSE API.

	  http://www.cybernoia.de/software/archivemount.html

comment "archivemount needs a toolchain w/ threads, wchar, dynamic library"
	depends on (!BR2_TOOLCHAIN_HAS_THREADS || BR2_PREFER_STATIC_LIB \
		    || !BR2_USE_WCHAR)
```

## package/cargo/Config.in.host
```kconfig
config BR2_PACKAGE_HOST_CARGO
	bool "host cargo"
	depends on BR2_PACKAGE_HOST_RUSTC_ARCH_SUPPORTS
	help
	  Cargo is the package manager for the Rust programming
	  language

	  https://crates.io/

config BR2_PACKAGE_HAS_HOST_CARGO
	bool

config BR2_PACKAGE_PROVIDES_HOST_CARGO
	string
	depends on BR2_PACKAGE_HAS_HOST_CARGO
	depends on BR2_PACKAGE_HOST_RUSTC_ARCH_SUPPORTS
```

## package/clutter/Config.in
```kconfig
config BR2_PACKAGE_CLUTTER
	bool "clutter"
	depends on BR2_PACKAGE_COGL
	depends on BR2_USE_WCHAR # glib2
	depends on BR2_TOOLCHAIN_HAS_THREADS # glib2
	depends on BR2_USE_MMU # glib2
	depends on BR2_INSTALL_LIBSTDCPP # pango
	select BR2_PACKAGE_LIBGLIB2
	select BR2_PACKAGE_ATK
	select BR2_PACKAGE_CAIRO
	select BR2_PACKAGE_JSON_GLIB
	select BR2_PACKAGE_PANGO
	help
	  Clutter is an open source software library for creating fast,
	  compelling, portable, and dynamic graphical user interfaces.

	  http://www.clutter-project.org

comment "clutter needs a toolchain w/ wchar, threads, C++"
	depends on BR2_USE_MMU
	depends on !BR2_USE_WCHAR || !BR2_TOOLCHAIN_HAS_THREADS || \
		!BR2_INSTALL_LIBSTDCPP

if BR2_PACKAGE_CLUTTER

menu "rendering backends"

config BR2_PACKAGE_CLUTTER_BACKEND_EGL
	bool "OpenGL EGL backend"
	depends on BR2_PACKAGE_HAS_LIBEGL
	help
	  This enables the OpenGL EGL framebuffer backend.

config BR2_PACKAGE_CLUTTER_BACKEND_WAYLAND
	bool "Wayland backend"
	depends on BR2_PACKAGE_WAYLAND
	select BR2_PACKAGE_GDK_PIXBUF
	help
	  This enables the Wayland backend.

config BR2_PACKAGE_CLUTTER_BACKEND_X11
	bool "X11 backend"
	depends on BR2_PACKAGE_XORG7
	select BR2_PACKAGE_XLIB_LIBX11
	select BR2_PACKAGE_XLIB_LIBXEXT
	select BR2_PACKAGE_XLIB_LIBXCOMPOSITE
	select BR2_PACKAGE_XLIB_LIBXFIXES
	select BR2_PACKAGE_XLIB_LIBXDAMAGE
	help
	  This enables the X11 backend.

endmenu

menu "input event listeners"

config BR2_PACKAGE_CLUTTER_INPUT_EVDEV
	bool "evdev"
	depends on BR2_PACKAGE_HAS_UDEV
	select BR2_PACKAGE_LIBXKBCOMMON
	select BR2_PACKAGE_LIBEVDEV
	select BR2_PACKAGE_LIBINPUT
	help
	  This enables support for evdev input events.

comment "evdev support needs udev /dev management"
	depends on !BR2_PACKAGE_HAS_UDEV

config BR2_PACKAGE_CLUTTER_INPUT_XINPUT
	bool "xinput"
	depends on BR2_PACKAGE_XORG7
	select BR2_PACKAGE_XLIB_LIBXI
	help
	  This enables support for xinput input events.

endmenu

config BR2_PACKAGE_CLUTTER_INSTALL_DEMOS
	bool "install demos"
	select BR2_PACKAGE_GDK_PIXBUF
	select BR2_PACKAGE_CAIRO_PNG
	help
	  Install the demo programs

endif
```

## package/cogl/Config.in
```kconfig
config BR2_PACKAGE_COGL
	bool "cogl"
	depends on BR2_PACKAGE_HAS_LIBGL || BR2_PACKAGE_HAS_LIBGLES
	depends on BR2_PACKAGE_XORG7 || BR2_PACKAGE_HAS_LIBWAYLAND_EGL
	depends on BR2_USE_WCHAR # glib2
	depends on BR2_TOOLCHAIN_HAS_THREADS # glib2
	depends on BR2_USE_MMU # glib2
	select BR2_PACKAGE_LIBGLIB2
	help
	  Cogl is an open source GPU graphics and utilities API providing:

	  - a hardware accelerated graphics API.
	  - math utilities (matrices, vectors, ...).
	  - texturing utilities.

	  http://www.cogl3d.org/

if BR2_PACKAGE_COGL

menu "drivers"

config BR2_PACKAGE_COGL_OPENGL_GL
	bool "OpenGL support"
	default y
	depends on BR2_PACKAGE_HAS_LIBGL
	help
	  This enables OpenGL support.

config BR2_PACKAGE_COGL_OPENGL_ES
	bool "OpenGL ES support"
	default y
	depends on BR2_PACKAGE_HAS_LIBGLES
	help
	  This enables OpenGL ES support.

endmenu

menu "window systems"

config BR2_PACKAGE_COGL_GLX
	bool "GLX support"
	depends on BR2_PACKAGE_HAS_LIBGL
	depends on BR2_PACKAGE_XORG7
	help
	  This enables GLX support.

config BR2_PACKAGE_COGL_SDL
	bool "SDL support"
	depends on BR2_PACKAGE_SDL
	help
	  This enables SDL support.

config BR2_PACKAGE_COGL_SDL2
	bool "SDL2 support"
	depends on BR2_PACKAGE_SDL2
	help
	  This enables SDL2 support.

config BR2_PACKAGE_COGL_EGL_XLIB
	bool "Xlib EGL support"
	depends on BR2_PACKAGE_HAS_LIBEGL
	depends on BR2_PACKAGE_XORG7
	select BR2_PACKAGE_XLIB_LIBXDAMAGE
	select BR2_PACKAGE_XLIB_LIBXRENDER
	select BR2_PACKAGE_XLIB_LIBXFIXES
	select BR2_PACKAGE_XLIB_LIBXCOMPOSITE
	help
	  This enables Xlib EGL support.

config BR2_PACKAGE_COGL_EGL_WAYLAND
	bool "Wayland EGL support"
	depends on BR2_PACKAGE_HAS_LIBWAYLAND_EGL
	help
	  This enables Wayland EGL support.

endmenu

config BR2_PACKAGE_COGL_INSTALL_DEMOS
	bool "install demos"
	help
	  Install the demo programs

endif

comment "cogl needs a toolchain w/ wchar, threads"
	depends on BR2_USE_MMU
	depends on !BR2_USE_WCHAR || !BR2_TOOLCHAIN_HAS_THREADS
```

## package/dub-bin/Config.in.host
```kconfig
config BR2_PACKAGE_HOST_DUB_BIN
	bool "host-dub-bin"
	depends on BR2_HOSTARCH = "x86_64" || BR2_HOSTARCH = "x86"
	depends on BR2_TOOLCHAIN_HAS_DLANG
	help
	  Package and build manager for D applications and libraries.

	  This package the binary host variant.

	  https://github.com/dlang/dub
```

## package/gradm/Config.in
```kconfig
config BR2_PACKAGE_GRADM
	bool "gradm"
	depends on BR2_LARGEFILE
	depends on BR2_USE_MMU # fork()
	depends on !BR2_avr32
	help
	  Administrative interface for the grsecurity Role Based Access
	  Control system.

	  Grsecurity is a set of patches for hardening the Linux kernel.
	  It provides:

	  - PaX: protection for memory pages.
	  - Role Based Access Control: a mechanism to restrict access to
	    objects (files, sockets, ...) by subjects (processes) based on
	    roles.
	  - and more!

	  This package provides gradm, a tool to manage the RBAC policy.

	  If the linux-pam package is selected, PAM authentification support
	  will be added (gradm_pam).

	  Your kernel needs to be properly patched and configured for this
	  program to have any effect.

	  http://grsecurity.net/

comment "gradm needs a toolchain w/ largefile"
	depends on BR2_USE_MMU
	depends on !BR2_LARGEFILE
```

## package/ipsvd/Config.in
```kconfig
config BR2_PACKAGE_IPSVD
	bool "ipsvd"
	help
	  Internet Protocols service daemons

	  http://smarden.org/ipsvd/
```

## package/libb2/Config.in
```kconfig
config BR2_PACKAGE_LIBB2
	bool "libb2"
	help
	  C library providing BLAKE2b, BLAKE2s, BLAKE2bp, BLAKE2sp hashing
	  functions.

	  https://blake2.net
```

## package/libgit2-glib/Config.in
```kconfig
config BR2_PACKAGE_LIBGIT2_GLIB
	bool "libgit2-glib"
	depends on BR2_USE_WCHAR # glib2
	depends on BR2_TOOLCHAIN_HAS_THREADS # glib2
	depends on BR2_USE_MMU # glib2
	select BR2_PACKAGE_LIBGLIB2
	select BR2_PACKAGE_LIBGIT2

	help
	  libgit2-glib is a glib wrapper library around the libgit2 git access
	  library.

	  https://git.gnome.org/browse/libgit2-glib

comment "libgit2-glib needs a toolchain w/ wchar, threads"
	depends on BR2_USE_MMU
	depends on !BR2_USE_WCHAR || !BR2_TOOLCHAIN_HAS_THREADS
```

## package/libgit2/Config.in
```kconfig
config BR2_PACKAGE_LIBGIT2
	bool "libgit2"
	help
	  libgit2 is a portable, pure C implementation of the Git core methods
	  provided as a re-entrant linkable library with a solid API, allowing
	  you to write native speed custom Git applications in any language
	  with bindings.

	  https://libgit2.github.com/
```

## package/libwayland-egl/Config.in
```kconfig
config BR2_PACKAGE_HAS_LIBWAYLAND_EGL
	bool

config BR2_PACKAGE_PROVIDES_LIBWAYLAND_EGL
	depends on BR2_PACKAGE_HAS_LIBWAYLAND_EGL
	string
```

## package/nsd/Config.in
```kconfig
config BR2_PACKAGE_NSD
	bool "nsd"
	depends on BR2_USE_MMU # fork()
	depends on BR2_TOOLCHAIN_HAS_THREADS
	help
	  NSD is an authoritative only, high performance, simple and open
	  source name server.

	  http://www.nlnetlabs.nl/projects/nsd/

comment "nsd needs a toolchain w/ threads"
	depends on BR2_USE_MMU
	depends on !BR2_TOOLCHAIN_HAS_THREADS
```

## package/paxctl/Config.in
```kconfig
config BR2_PACKAGE_PAXCTL
	bool "paxctl"
	help
	  paxctl is a tool that allows PaX flags to be modified on a
	  per-binary basis. It is part of Grsecurity.

	  Grsecurity is a set of patches for hardening the Linux kernel.
	  It provides:

	  - PaX: protection for memory pages.
	  - Role Based Access Control: a mechanism to restrict access to
	    objects (files, sockets, ...) by subjects (processes) based on
	    roles.
	  - and more!

	  This program needs a properly patched and configured kernel to have
	  any effect.

	  http://pax.grsecurity.net
```

## package/python-pycairo/Config.in
```kconfig
config BR2_PACKAGE_PYTHON_PYCAIRO
	bool "python-pycairo"
	select BR2_PACKAGE_CAIRO
	select BR2_PACKAGE_PYTHON_XPYB
	depends on BR2_PACKAGE_PYTHON
	help
	  Python bindings for cairo

	  http://www.cairographics.org/pycairo
```

## package/python-pygobject/Config.in
```kconfig
config BR2_PACKAGE_PYTHON_PYGOBJECT
	bool "python-pygobject"
	select BR2_PACKAGE_LIBGLIB2
	depends on BR2_PACKAGE_PYTHON
	depends on BR2_USE_WCHAR # libglib2
	depends on BR2_TOOLCHAIN_HAS_THREADS # libglib2
	depends on BR2_USE_MMU # libglib2
	help
	  Bindings for GLib, GObject and GIO.

	  http://pygtk.org/

comment "python-gobject needs a toolchain w/ wchar, threads"
	depends on BR2_USE_MMU
	depends on !BR2_USE_WCHAR || !BR2_TOOLCHAIN_HAS_THREADS
```

## package/python-pygtk/Config.in
```kconfig
config BR2_PACKAGE_PYTHON_PYGTK
	bool "python-pygtk"
	select BR2_PACKAGE_LIBGTK2
	select BR2_PACKAGE_PYTHON_PYCAIRO
	select BR2_PACKAGE_PYTHON_PYGOBJECT
    select BR2_PACKAGE_LIBGLADE
	depends on BR2_PACKAGE_PYTHON
	help
	  Python bindings for GTK+ 2.0

	  http://www.pygtk.org
```

## package/python-xpyb/Config.in
```kconfig
config BR2_PACKAGE_PYTHON_XPYB
	bool "python-xpyb"
	select BR2_PACKAGE_LIBXCB_
	select BR2_PACKAGE_XCB_PROTO
	depends on BR2_PACKAGE_XORG7
	depends on BR2_PACKAGE_PYTHON
	help
	  X Python Binding, based on the X C Binding (XCB) library

	  http://xcb.freedesktop.org/
```

## package/qt5/qt5wayland/Config.in
```kconfig
config BR2_PACKAGE_QT5WAYLAND
	bool "qt5wayland"
	depends on BR2_PACKAGE_QT5BASE
	depends on BR2_PACKAGE_QT5DECLARATIVE
	depends on BR2_PACKAGE_WAYLAND
	select BR2_PACKAGE_LIBXKBCOMMON
	help
	  Qt is a cross-platform application and UI framework for
	  developers using C++.

	  This package wraps the functionality of Wayland.

	  http://qt.gitorious.org/qt/qtwayland

if BR2_PACKAGE_QT5WAYLAND
	config BR2_PACKAGE_QT5WAYLAND_COMPOSITOR_API
	bool "Enable QtCompositor API"
	help
	  Enable the experimental QtCompositor API
endif
```

## package/runit/Config.in
```kconfig
config BR2_PACKAGE_RUNIT
	bool "runit"
	help
	  /sbin/init - parent of all processes

	  http://smarden.org/runit/
```

## package/unbound/Config.in
```kconfig
config BR2_PACKAGE_UNBOUND
	bool "unbound"
	depends on BR2_USE_MMU # fork()
	depends on BR2_TOOLCHAIN_HAS_THREADS
	depends on !BR2_PREFER_STATIC_LIB # dlopen()
	select BR2_PACKAGE_EXPAT
	help
	  Unbound is a validating, recursive, and caching DNS resolver.

	  http://unbound.net/

comment "unbound needs a toolchain w/ threads, dynamic library"
	depends on BR2_USE_MMU
	depends on !BR2_TOOLCHAIN_HAS_THREADS
	depends on BR2_PREFER_STATIC_LIB
```

## package/xgxperf/Config.in
```kconfig
config BR2_PACKAGE_XGXPERF
	bool "xgxperf"
	depends on BR2_PACKAGE_QT5
	select BR2_PACKAGE_QT5SVG
	help
	  UI performance templates for Qt5 (based on C++)

	  https://github.com/prabindh/xgxperf
```
